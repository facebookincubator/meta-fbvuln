## conf/layer.conf
```bitbake
#
# Copyright (c) Facebook, Inc. and its affiliates.
#
# This source code is licensed under the MIT license found in the
# LICENSE file in the root directory of this source tree.
#

BBPATH .= ":${LAYERDIR}"

#
# This layer has no recipes or appends, so the BBFILE_* variables
# should remain undefined.
#
# This, in turn, means that LAYERSERIES_COMPAT_* can't be resolved for
# this layer, and that it's not even checked.
#
```
